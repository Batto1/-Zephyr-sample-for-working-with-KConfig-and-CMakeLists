## app/example_module/Kconfig
```kconfig
menuconfig EXAMPLE_MODULE
	bool "Whether to incorporte example module into the application or not"
	help
	  Uses example module if chosen.

if EXAMPLE_MODULE


config EXAMPLE_MODULE_CONF
	bool "Some example conf option"
	default y
	help
	  Some example conf option

rsource "Kconfig.other_conf"

endif # EXAMPLE_MODULE
	  
	
```

## src/example_module/Kconfig.other_conf
```kconfig
	  
	  
config EXAMPLE_NUMERIC_CONF_1
	int "Some numeric configuration"
	default 123
	help
	  Some numeric configuration

config EXAMPLE_NUMERIC_CONF_2
	int "Some numeric configuration"
	default 123
	help
	  Some numeric configuration
```
