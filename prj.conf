## CMakeLists.txt
```
# SPDX-License-Identifier: Apache-2.0

cmake_minimum_required(VERSION 3.20.0)

find_package(Zephyr REQUIRED HINTS $ENV{ZEPHYR_BASE})
project(working_with_kconfig_and_cmakelists_with_nested_files)




# add_subdirectory(app)

add_subdirectory_ifdef(CONFIG_CUSTOM_CONFIG_EXAMPLE app)
```

## Kconfig
```
# Subsystem configuration options

# Copyright (c) 2016-2017 Intel Corporation
# Copyright (c) 2021 Nordic Semiconductor
# SPDX-License-Identifier: Apache-2.0
source "Kconfig.zephyr"



config CUSTOM_CONFIG_EXAMPLE
	bool "Custom config example"
	help
	  Custom config example for trying to from nested Kconfig.
	  


rsource "app/Kconfig"  
	 
```

## prj.conf
```kconfig
# nothing here

CONFIG_CUSTOM_CONFIG_EXAMPLE=y

CONFIG_EXAMPLE_MODULE=y


CONFIG_EXAMPLE_MODULE_CONF=y
CONFIG_EXAMPLE_NUMERIC_CONF_1=100
CONFIG_EXAMPLE_NUMERIC_CONF_2=200
```

## src/main.c
```c
/*
 * https://github.com/zephyrproject-rtos/example-application/tree/94bd8c7413489e3e77f5cf2898ff25bf933dae13
 */

#include <stdio.h>
#include "example_module.h"

int main(void)
{
	printk("Hello World! %s\n", CONFIG_BOARD);

	printk("%d %d %d \n", Return_CONFIG_EXAMPLE_MODULE_CONF(), Return_CONFIG_EXAMPLE_NUMERIC_CONF_1(), Return_CONFIG_EXAMPLE_NUMERIC_CONF_2());


	return 0;
}
```
